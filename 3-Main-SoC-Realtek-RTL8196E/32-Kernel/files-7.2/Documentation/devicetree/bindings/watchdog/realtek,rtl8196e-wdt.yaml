## 3-Main-SoC-Realtek-RTL8196E/32-Kernel/files-7.2/Documentation/devicetree/bindings/watchdog/realtek,rtl8196e-wdt.yaml
```yaml
# SPDX-License-Identifier: GPL-2.0-only
%YAML 1.2
---
$id: http://devicetree.org/schemas/watchdog/realtek,rtl8196e-wdt.yaml#
$schema: http://devicetree.org/meta-schemas/core.yaml#

title: Realtek RTL8196E hardware watchdog

maintainers:
  - Jacques Nilo <jnilo@free.fr>

description: |
  The RTL8196E SoC exposes a single 32-bit Watchdog Timer Control
  Register (WDTCNR) at sysc + 0x311C. The driver decodes WDIND for
  reset-cause reporting, OVSEL[3:0] for bucket selection, and uses
  WDTCLR for the kick. See the RTL8196E-CG datasheet table 27 for
  the full layout. CDBR is shared with Timer0 and Timer1; at the current
  25 kHz tick the maximum 2^24 overflow bucket is about 671 seconds.

allOf:
  - $ref: watchdog.yaml#

properties:
  compatible:
    const: realtek,rtl8196e-wdt

  reg:
    maxItems: 1
    description: |
      The 32-bit WDTCNR register. Address is the offset within the
      RTL8196E system controller block (sysc + 0x311C).

  timeout-sec: true

required:
  - compatible
  - reg

unevaluatedProperties: false

examples:
  - |
    soc {
        #address-cells = <1>;
        #size-cells = <1>;

        watchdog@311c {
            compatible = "realtek,rtl8196e-wdt";
            reg = <0x311c 0x4>;
            timeout-sec = <1>;
        };
    };
```

## 3-Main-SoC-Realtek-RTL8196E/32-Kernel/files-7.2/arch/mips/realtek/Kconfig
```kconfig
# SPDX-License-Identifier: GPL-2.0
if REALTEK

choice
	prompt "Realtek SoC selection"
	default SOC_RTL8196E
	help
	  Select Realtek SoC type.

	config SOC_RTL8196E
		bool "RTL8196E"
		select ARCH_NO_PREEMPT
		select USE_GENERIC_EARLY_PRINTK_8250
		select SYS_SUPPORTS_BIG_ENDIAN
		select SYS_HAS_CPU_RLX4181
		select HW_HAS_PCI
		select GPIOLIB
		select GPIO_GENERIC
		select GPIOLIB_IRQCHIP
		select RTL819X_INTC
		select CLKSRC_RTL819X
		select SYS_SUPPORTS_ZBOOT
		select SYS_SUPPORTS_ZBOOT_UART16550

endchoice

choice
	prompt "Devicetree selection"
	default DTB_RTK_NONE
	help
	  Select the board devicetree built into the kernel image.
	  Exactly one dtb is linked in (BUILTIN_DTB / __dtb_start).

	  To add a board: write the dts in arch/mips/boot/dts/realtek/
	  (include rtl819x.dtsi, override memory size, gpio-line-names,
	  the radio-bridge node and the ethernet interface), add a
	  choice entry here and the dtb- line in that directory's
	  Makefile. build_kernel.sh selects the entry via BOARD=<name>.

	config DTB_RTK_NONE
		bool "None"

	config DTB_RTL8196E_GEN
		bool "Lidl Silvercrest Gateway (rtl8196e.dtb)"
		depends on SOC_RTL8196E
		select BUILTIN_DTB

	config DTB_RTL8196E_SENGLED_E39_G8C
		bool "Sengled Smart Hub G4 E39-G8C (rtl8196e-sengled-e39-g8c.dtb)"
		depends on SOC_RTL8196E
		select BUILTIN_DTB

endchoice

config RTL8196E_IMEM
	bool "Use on-chip I-MEM for hot-path functions"
	depends on SOC_RTL8196E
	default y
	help
	  Place hot-path functions (IRQ dispatch, NAPI poll, TX submit,
	  DMA cache ops) in the 16 KB on-chip instruction SRAM (I-MEM)
	  for zero wait-state instruction fetch.  The RLX4181 COP3
	  coprocessor maps a 16 KB SDRAM region to the on-chip SRAM
	  at boot time via IRAM Fill.

	  If unsure, say Y.

config RTL8196E_IMEM_DEFAULT_PLACEMENT
	bool "Place the default set of hot functions in I-MEM"
	depends on RTL8196E_IMEM
	default y
	help
	  When enabled (the production default), the existing __iram /
	  __iram_hotpath / __iram_gen / __iram_fwd annotations scattered
	  across the tree resolve to real section attributes, and the
	  matching functions are loaded into on-chip I-MEM at boot.

	  When disabled, those annotations expand to nothing.  Functions
	  marked with the dedicated __iram_poc macro still get placed
	  (controlled by RTL8196E_IMEM_POC_IRAM below), which lets the
	  IRAM PoC isolate one or two specific functions in I-MEM without
	  competing for the 16 KB budget with the rest of the default set.

	  Disable only for IRAM PoC measurements.  Keep Y for production.

config RTL8196E_IMEM_POC_IRAM
	bool "Activate __iram_poc placement (PoC code in I-MEM)"
	depends on RTL8196E_IMEM
	default n
	help
	  When enabled, functions annotated with __iram_poc are placed in
	  the .iram linker section and loaded into on-chip I-MEM.  Used
	  by the IRAM PoC to opt one or two specific functions into IRAM
	  in isolation (typically alongside RTL8196E_IMEM_DEFAULT_PLACEMENT=n).

# CONFIG_RTL8196E_IMEM_POC_DRAM was removed in v3.4.2: the v3.4.0 IRAM
# PoC measured -4 % UDP TX when ring metadata was placed in DMEM, so no
# code carries __dram_poc annotations and the option became dead config.
# The DMEM init code is preserved in imem.S as the documented 4-stage
# SDRAM->DMEM copy sequence; .dram stays empty at boot and the init
# path takes its skip_dram branch.

config RTL8196E_ICACHE_PROBE
	bool "I-cache geometry probe (diagnostic, /proc trigger)"
	default n
	help
	  Build a diagnostic that measures the instruction-cache geometry --
	  associativity and effective conflict penalty -- by timing generated
	  jump chains executed from KSEG0.  The RLX4181 has no PMU and no CP0
	  Count, and CP0 Config reads zero on this part, so timing is the only
	  instrument available.

	  Nothing runs at boot.  The sweep executes only on an explicit read of
	  /proc/rtl8196e_icache_probe (mode 0400).  Each timed batch masks
	  interrupts for a few hundred microseconds.

	  This is measurement scaffolding, not a feature.  Say N for
	  production; enable it only for a probe campaign.

endif
```

## 3-Main-SoC-Realtek-RTL8196E/32-Kernel/files-7.2/drivers/net/ethernet/rtl8196e-eth/Kconfig
```kconfig
# SPDX-License-Identifier: GPL-2.0
config RTL8196E_ETH
	tristate "Realtek RTL8196E Ethernet (new, recommended)"
	depends on MIPS && OF && !SMP
	help
	  Clean-room RTL8196E Ethernet driver: single-port, NAPI, zero-copy
	  RX/TX. Replaces the legacy rtl819x SDK port with maintainable code.

	  The lockless ring cursors and bare per-CPU-less counters rely on the
	  single-core (UP) serialization of this SoC; it depends on !SMP so a
	  future multi-core port cannot silently inherit the unsynchronised
	  fast paths.

	  Delivers ~94 Mbps TCP RX and ~73 Mbps TCP TX on the Lexra RLX4181
	  (RTL8196E at 400 MHz). Configured via devicetree (interface@0 node).
```

## 3-Main-SoC-Realtek-RTL8196E/32-Kernel/files-7.3/Documentation/devicetree/bindings/gpio/realtek,rtl8196e-gpio.yaml
```yaml
# SPDX-License-Identifier: GPL-2.0-only
%YAML 1.2
---
$id: http://devicetree.org/schemas/gpio/realtek,rtl8196e-gpio.yaml#
$schema: http://devicetree.org/meta-schemas/core.yaml#

title: Realtek RTL8196E GPIO controller

maintainers:
  - Jacques Nilo <jnilo@free.fr>

description: |
  One 32-line bank across four 8-bit ports (A = 0-7, B = 8-15, C = 16-23,
  D = 24-31), driven by the generic MMIO GPIO core: DATA at offset 0x0c and
  DIR at 0x08.

  Pads B2-B6 (offsets 10-14) are shared between this controller and the switch
  core's ASIC LED outputs LED_PORT0-4. Ownership of each shared pad is decided
  by two properties on THIS node, and both the GPIO driver and the Ethernet
  driver read them, so the two never fight over PIN_MUX_SEL_2:

    * a non-empty gpio-line-names entry claims the pad for GPIO;
    * an entry in realtek,led-pads claims it for the ASIC LED function;
    * a pad claimed by neither is left in GPIO/Hi-Z, provided
      realtek,led-pads is present at all.

  If realtek,led-pads is absent entirely, every unnamed pad falls back to the
  ASIC LED function — which is why a board that overrides gpio-line-names must
  review this property in the same change.

  A schema cannot catch an electrically wrong but syntactically valid pad
  number: choosing the pad the board did not wire produces a dead LAN LED that
  reads back perfectly correct. Board bring-up must still include a visual
  LED check.

properties:
  compatible:
    const: realtek,rtl8196e-gpio

  reg:
    maxItems: 1

  gpio-controller: true

  "#gpio-cells":
    const: 2

  gpio-line-names:
    minItems: 32
    maxItems: 32

  realtek,syscon:
    $ref: /schemas/types.yaml#/definitions/phandle
    description: |
      System controller holding PIN_MUX_SEL_2 (0x44), the pad-mux register for
      the shared pads B2-B6. Required: without it offsets 10-14 cannot be
      switched to GPIO mode, so the driver fails to probe rather than leaving
      those lines silently stuck in peripheral mode.

  realtek,led-pads:
    $ref: /schemas/types.yaml#/definitions/uint32-array
    minItems: 1
    maxItems: 5
    uniqueItems: true
    items:
      minimum: 10
      maximum: 14
    description: |
      GPIO offsets of the shared pads B2-B6 that this board wires to the switch
      core's ASIC LED outputs instead of to GPIO. Only offsets 10-14 are
      muxable; any other value describes a pad that does not exist as a shared
      pad. Lidl/Silvercrest uses <14> (B6, LAN LED); the Sengled E39-G8C uses
      <10> (B2).

required:
  - compatible
  - reg
  - gpio-controller
  - "#gpio-cells"
  - realtek,syscon

additionalProperties: false

examples:
  - |
    soc {
        #address-cells = <1>;
        #size-cells = <1>;

        gpio-controller@3500 {
            compatible = "realtek,rtl8196e-gpio";
            reg = <0x3500 0x38>;
            gpio-controller;
            #gpio-cells = <2>;
            realtek,syscon = <&sysc>;
            gpio-line-names =
                "", "", "", "", "", "", "", "",
                "", "reset-button", "", "status-led",
                "efr32-nrst", "", "", "",
                "", "", "", "", "", "", "", "",
                "", "", "", "", "", "", "", "";
            realtek,led-pads = <14>;
        };
    };
```

## 3-Main-SoC-Realtek-RTL8196E/32-Kernel/files-7.3/Documentation/devicetree/bindings/leds/leds-gpio-pwm.yaml
```yaml
# SPDX-License-Identifier: GPL-2.0-only OR BSD-2-Clause
%YAML 1.2
---
$id: http://devicetree.org/schemas/leds/leds-gpio-pwm.yaml#
$schema: http://devicetree.org/meta-schemas/core.yaml#

title: LEDs connected to non-sleeping GPIO lines with software PWM

maintainers:
  - J. Nilo <jnilo@free.fr>

description:
  GPIO LEDs whose intermediate brightness is generated by a jiffies-based
  software PWM timer.  The GPIO controller must be safe for atomic MMIO access.

properties:
  compatible:
    const: gpio-leds-pwm

patternProperties:
  "(^led-[0-9a-f]$|led)":
    type: object
    $ref: common.yaml#
    unevaluatedProperties: false

    properties:
      gpios:
        maxItems: 1

      retain-state-suspended: false
      retain-state-shutdown: false
      panic-indicator: false

    required:
      - gpios

additionalProperties: false

examples:
  - |
    #include <dt-bindings/gpio/gpio.h>

    leds {
        compatible = "gpio-leds-pwm";

        status-led {
            label = "status";
            gpios = <&gpio0 11 GPIO_ACTIVE_LOW>;
            default-state = "off";
        };
    };

...
```

## 3-Main-SoC-Realtek-RTL8196E/32-Kernel/files-7.3/Documentation/devicetree/bindings/timer/realtek,rtl8196e-timer.yaml
```yaml
# SPDX-License-Identifier: (GPL-2.0-only OR BSD-2-Clause)
%YAML 1.2
---
$id: http://devicetree.org/schemas/timer/realtek,rtl8196e-timer.yaml#
$schema: http://devicetree.org/meta-schemas/core.yaml#

title: Realtek RTL8196E timer controller

maintainers:
  - Jacques Nilo <jnilo@free.fr>

description: |
  The RTL8196E timer controller provides two 28-bit counters. Timer0 is
  used as a one-shot clockevent and Timer1 as the free-running clocksource.
  Their clock divider is shared with the adjacent on-chip watchdog, so both
  the reference tick and the bus clock are required to derive an exact
  divider.

properties:
  $nodename:
    pattern: "^timer@[0-9a-f]+$"

  compatible:
    oneOf:
      - items:
          - const: realtek,rtl8196e-timer
          - const: realtek,rtl819x-timer
      - const: realtek,rtl819x-timer
        deprecated: true

  reg:
    maxItems: 1
    description: Timer registers DATA0 through CDBR, excluding WDTCNR.

  interrupts:
    maxItems: 1

  clocks:
    items:
      - description: Timer0, Timer1 and watchdog reference tick
      - description: SoC bus clock used as the CDBR divider input

  clock-names:
    items:
      - const: refclk
      - const: busclk

required:
  - compatible
  - reg
  - interrupts
  - clocks
  - clock-names

additionalProperties: false

examples:
  - |
    timer@3100 {
        compatible = "realtek,rtl8196e-timer", "realtek,rtl819x-timer";
        reg = <0x3100 0x1c>;
        interrupts = <7>;
        clocks = <&slowclk>, <&busclk>;
        clock-names = "refclk", "busclk";
    };
...
```

## 3-Main-SoC-Realtek-RTL8196E/32-Kernel/files-7.3/drivers/net/rtl8196e-uart-bridge/Kconfig
```kconfig
# SPDX-License-Identifier: GPL-2.0
config RTL8196E_UART_BRIDGE
	bool "Realtek RTL8196E in-kernel UART<->TCP bridge"
	depends on MIPS && SERIAL_8250 && INET && GPIOLIB
	help
	  In-kernel byte shoveler between a TTY port (typically /dev/ttyS1,
	  the link to the Silabs EFR32 Zigbee/Thread radio) and a listening
	  TCP socket. Replaces the userspace serialgateway daemon, removing
	  the user/kernel context-switch overhead per byte that capped the
	  earlier daemon at moderate baud rates on the single-core Lexra
	  RLX4181. Sustains 892857 baud (the SoC's N+1 divisor maximum) with
	  no overrun/framing errors under multi-hour soak.

	  Protocol-agnostic: forwards raw bytes in both directions, used by
	  EZSP (NCP), CPC (RCP), and Spinel (OT-RCP) clients alike.

	  Also provides the nrst_pulse / nrst_gpio sysfs knobs that recover
	  a stuck radio by pulsing the EFR32 nRST line low through the
	  gpio-rtl819x chip (hence the GPIOLIB dependency), and the
	  blmode_pulse / blmode_gpio knobs that reset the radio into its
	  Gecko bootloader on boards that wire the bootloader-entry pin to
	  a SoC GPIO (e.g. the Sengled G4; disabled when blmode_gpio=-1,
	  the Lidl default).

	  Must be built in (=y), not as a module. The driver registers at
	  late_initcall and depends on the tty/serial and net subsystems
	  being initialized; there is no module exit path because the
	  driver is never unloaded.

	  If unsure, say N.
```
